/*
 * Copyright (c) 2026 The ZMK Contributors
 *
 * SPDX-License-Identifier: MIT
 */

/ {
    behaviors {
        // Forwarded to the peripherals, so the node name must stay <= 8 characters
        // (see ZMK_SPLIT_RUN_BEHAVIOR_DEV_LEN in ZMK).
        reset_now: resetnow {
            compatible = "zmk,behavior-reset-now";
            #binding-cells = <0>;
            hold-time-ms = <500>;
        };
    };
};
