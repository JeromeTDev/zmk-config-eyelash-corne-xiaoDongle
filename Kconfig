## Kconfig
```kconfig
DT_COMPAT_ZMK_BEHAVIOR_RESET_NOW := zmk,behavior-reset-now

config ZMK_BEHAVIOR_RESET_NOW
    bool
    default $(dt_compat_enabled,$(DT_COMPAT_ZMK_BEHAVIOR_RESET_NOW))
```

## config/west.yml
```yaml
manifest:
    remotes:
        - name: zmkfirmware
          url-base: https://github.com/zmkfirmware
        - name: m165437
          url-base: https://github.com/M165437
        - name: gpeye
          url-base: https://github.com/GPeye
        - name: englmaxi
          url-base: https://github.com/englmaxi
    projects:
        - name: zmk
          remote: zmkfirmware
          revision: v0.3
          import: app/west.yml
        - name: nice-view-gem
          remote: m165437
          revision: v0.3.0
        - name: zmk-dongle-display
          remote: englmaxi
          revision: v0.3
    self:
        path: config
```

## dts/bindings/behaviors/zmk,behavior-reset-now.yaml
```yaml
# Copyright (c) 2026 The ZMK Contributors
# SPDX-License-Identifier: MIT

description: A behavior that soft-resets the keyboard when released after being held.

compatible: "zmk,behavior-reset-now"

include: zero_param.yaml

properties:
  hold-time-ms:
    type: int
    default: 500
```

## dts/bindings/behaviors/zmk,behavior-sleep-now.yaml
```yaml
# Copyright (c) 2026 The ZMK Contributors
# SPDX-License-Identifier: MIT

description: A behavior that puts the keyboard into deep sleep when released after being held.

compatible: "zmk,behavior-sleep-now"

include: zero_param.yaml

properties:
  hold-time-ms:
    type: int
    default: 500
```
